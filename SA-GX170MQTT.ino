#include <Arduino.h>
#include <IRremoteESP8266.h>
#include <IRsend.h>
#include <ESP8266WiFi.h>
#include <PubSubClient.h>

//DEFINITIONS
#define irLed 5 //D1
#define onBoardLED 2
#define speakersA 4 //D2
#define speakersB 0 //D3
#define phono 15 //D5

//MQTT - HOME ASSISTANT AND WIFI DATA
const char* wifiSSID = "";
const char* wifiPwd = "";
const char* mqttServerAddress = "";
const char* mqttUserName = "";
const char* mqttPwd = "";
const char* mqttClientID = "Technics SA-GX170";

//REMOTE CONTROL RAW DATA (PRONTO RAW PROTOCOL)

//POWER
uint16_t powerC[104] = { 0x0000, 0x0070, 0x0000, 0x0032, 0x0080, 0x003f, 0x0011, 0x000f, 0x0011, 0x002f, 0x0011, 0x000f, 0x0011,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 0x0011, 0x0aa8 };

//VOL+
uint16_t volPlusC[104]= { 0x0000, 0x0070, 0x0000, 0x0032, 0x0080, 0x0040, 0x0010, 0x0010, 0x0010, 0x0030, 0x0010, 0x0010, 0x0010,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 0x0010, 0x0aa9 };

//VOL-
uint16_t volMinusC[104]= { 0x0000, 0x0070, 0x0000, 0x0032, 0x0080, 0x003f, 0x0011, 0x000f, 0x0011, 0x002f, 0x0011, 0x000f, 0x0011,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 0x0011, 0x0aa8 };

//VCR1 
uint16_t vcr1C[104]= { 0x0000, 0x0070, 0x0000, 0x0032, 0x0080, 0x0040, 0x0010, 0x0010, 0x0010, 0x0030, 0x0010, 0x0010, 0x0010,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 0x0010, 0x0aa9 };

//TAPE MONITOR
uint16_t tMonC[104]= { 0x0000, 0x0070, 0x0000, 0x0032, 0x0080, 0x0040, 0x0010, 0x0010, 0x0010, 0x0030, 0x0010, 0x0010, 0x0010,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 0x0010, 0x0aba };

//CD
uint16_t cdC[104]= { 0x0000, 0x0070, 0x0000, 0x0032, 0x0080, 0x0040, 0x0010, 0x0010, 0x0010, 0x0030, 0x0010, 0x0010, 0x0010,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 0x0010, 0x0aba };

//TUNER
uint16_t tunerC[104]= { 0x0000, 0x0070, 0x0000, 0x0032, 0x0080, 0x0040, 0x0010, 0x0010, 0x0010, 0x0030, 0x0010, 0x0010, 0x0010,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 0x0010, 0x0aba };

//MUTE
uint16_t muteC[104]= { 0x0000, 0x0070, 0x0000, 0x0032, 0x0080, 0x0040, 0x0010, 0x0010, 0x0010, 0x0030, 0x0010, 0x0010, 0x0010,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 0x0010, 0x0aba };

//INITIALIZATIONS
WiFiClient espClient;
IRsend irsend(irLed); 
PubSubClient client(espClient);

String strTopic;
String strPayload;
bool power;
bool muting;

//WIFI SETUP
void wifiSetup() {
  Serial.println("");
  delay(10);
  Serial.print("Connecting to: ");
  Serial.println(wifiSSID);
  WiFi.begin(wifiSSID, wifiPwd);

  while (WiFi.status() != WL_CONNECTED)
  {
    delay(500);
    Serial.print(".");
  }

  Serial.println("");
  Serial.print("Connected! - IP address: ");
  Serial.println(WiFi.localIP());
}

//MQTT CALLBACK FUNCTION
void mqttCallback(char* topic, byte* payload, unsigned int length) {
  payload[length] = '\0';
  strTopic = String((char*)topic);
  
  //HARDWARE BUTTONS (OPTOCOUPLERS)
  if (strTopic == "cmnd/technics/hwbuttons"){
    switch((char)payload[0]){
      case 'a':
        Serial.println("Pressing button: Speakers A");
        digitalWrite(speakersA, HIGH);
        delay(50);
        digitalWrite(speakersA, LOW);
        Serial.println("Released button: Speakers A");
      break;
      case 'b':
        Serial.println("Pressing button: Speakers B");
        digitalWrite(speakersB, HIGH);
        delay(50);
        digitalWrite(speakersB, LOW);
        Serial.println("Released button: Speakers B");
      break;
      case 'p':
        Serial.println("Pressing button: phono");
        digitalWrite(phono, HIGH);
        delay(50);
        digitalWrite(phono, LOW);
        Serial.println("Released button: phono");
      break;
    }
  }

  //IR Commands
  if (strTopic == "cmnd/technics")
  {
    switch((char)payload[0]) 
    {
      case '1':
        Serial.println("Sent signal: Power");
        irsend.sendPronto(powerC, 104);
        power=!power;
        if (power)
        {
          client.publish("stat/technics/power", "ON");
        }
        else
        {
          client.publish("stat/technics/power", "OFF");
        }
      break;
      case '2':
        Serial.println("Sent signal: VOL + SHORT");
        for (int i=0; i<5; i++){
          irsend.sendPronto(volPlusC, 104);
        }
        client.publish("stat/technics/vol", "1");
      break;
      case '3':
        Serial.println("Sent signal: VOL + LONG");
        for (int i=0; i<15; i++){
          irsend.sendPronto(volPlusC, 104);
        }
        client.publish("stat/technics/vol", "1");
      break;
      case '4':
        Serial.println("Sent signalL: VOL -");
        for (int i=0; i<15; i++){
          irsend.sendPronto(volMinusC, 104);
        }
      break;
      case '5':
        Serial.println("Sent signal: VOL - DOWN TO 0");
        for (int i=0; i<100; i++){
          irsend.sendPronto(volMinusC, 104);
        }
        client.publish("stat/technics/vol", "0");
      break;  
      case '6':
        Serial.println("Sent signal: VCR1");
        irsend.sendPronto(vcr1C, 104);
        irsend.sendPronto(tMonC, 104);
        client.publish("stat/technics/input", "1");
        client.publish("stat/technics/tmon", "1");
      break;
      case '7':
        Serial.println("Sent signal: CD");
        irsend.sendPronto(cdC, 104);
        irsend.sendPronto(tMonC, 104);
        client.publish("stat/technics/input", "3");
        client.publish("stat/technics/tmon", "1");
      break;
      case '8':
        Serial.println("Sent signal: TAPE MONITOR");
        irsend.sendPronto(tMonC, 104);
        client.publish("stat/technics/tmon", "0");
      break;
      case '9':
        Serial.println("Sent signal: TUNER");
        irsend.sendPronto(tunerC, 104);
        irsend.sendPronto(tMonC, 104);
        client.publish("stat/technics/input", "4");
        client.publish("stat/technics/tmon", "1");
      break;
      case 'a':
        Serial.println("Sent signal: MUTE");
        irsend.sendPronto(muteC, 104);
        muting=!muting;
        if (muting)
        {
          client.publish("stat/technics/muting", "1");
        }
        else
        {
          client.publish("stat/technics/muting", "0");
        }
      break;
    }
  } 
  digitalWrite(irLed, LOW);
}

//MQTT RECONNECT
void mqttReconnect() {
  while (!client.connected()) {
    Serial.print("Attempting MQTT connection...");
    if (client.connect(mqttClientID, mqttUserName, mqttPwd)) {
      Serial.println("Connected to Home Assistant MQTT Broker");
      //MQTT SUBSCRIPTIONS
      client.subscribe("avail/technics");
      client.subscribe("cmnd/technics");
      client.subscribe("cmnd/technics/pronto");
      client.subscribe("cmnd/technics/hwbuttons");
      client.subscribe("stat/technics/power");
      client.subscribe("stat/technics/input");
      client.subscribe("stat/technics/vol");
      client.subscribe("stat/technics/muting");
      client.subscribe("stat/technics/tmon");
      client.publish("avail/technics", "Online");
    } else {
      Serial.print("Failed: ");
      Serial.print(client.state());
      Serial.println("Trying again in 5 seconds...");
      delay(5000);
    }
  }
}

//SETUP
void setup() {
  Serial.begin(115200);
  pinMode(onBoardLED, OUTPUT);
  digitalWrite(onBoardLED, LOW);
  pinMode(speakersA, OUTPUT);
  digitalWrite(speakersA, LOW);
  pinMode(speakersB, OUTPUT);
  digitalWrite(speakersB, LOW);
  pinMode(phono, OUTPUT);
  digitalWrite(phono, LOW);
  wifiSetup();
  client.setServer(mqttServerAddress, 1883);
  client.setCallback(mqttCallback);
  digitalWrite(onBoardLED, LOW);
  irsend.begin();
}

//LOOP
void loop() {
  if (!client.connected()) {
    mqttReconnect();
  }
  client.loop();   
}
